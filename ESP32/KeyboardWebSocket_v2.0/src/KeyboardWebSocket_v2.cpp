#include <Arduino.h>
#include "freertos/FreeRTOS.h"
#include "freertos/task.h"

#include <WiFi.h>
#include <AsyncTCP.h>
#include <ESPAsyncWebServer.h>

#include <Wire.h>
#include <Adafruit_GFX.h>
#include <Adafruit_SSD1306.h>

#define SCREEN_WIDTH 128 // OLED display width, in pixels
#define SCREEN_HEIGHT 64 // OLED display height, in pixels
// Declaration for an SSD1306 display connected to I2C (SDA, SCL pins)
Adafruit_SSD1306 display(SCREEN_WIDTH, SCREEN_HEIGHT, &Wire, -1);

const char* ssid = "Bao Tu Trong Trung_2.4G";
const char* password = "@2022.com";


// Create AsyncWebServer object on port 80
AsyncWebServer server(80);
AsyncWebSocket ws("/ws");

const int ledPins[8] = {12, 14, 27, 26, 25, 33, 32, 5};
const int buzzerPins = 23;
bool SOUND = true; 
bool LEDINF = false;
bool ALARM = false;

volatile int frame = 0;
#define FRAME_COUNT (sizeof(ledOnFrames) / sizeof(ledOnFrames[0]))
const byte PROGMEM ledOnFrames[][288] = {
  {0,0,0,0,0,0,0,0,0,0,0,0,0,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0,0},
  {0,0,0,0,0,0,0,0,0,0,0,0,0,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0,0},
  {0,0,0,0,0,0,0,0,0,0,0,0,0,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0,0},
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  {0,0,0,0,0,0,0,0,0,0,0,0,0,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0,0}
};
const byte PROGMEM ledOffFrames[][288] = {
  {0,0,0,0,0,0,0,0,0,0,0,0,0,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0,0},
  {0,0,0,0,0,0,0,0,0,0,0,0,0,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0,0},
  {0,0,0,0,0,0,0,0,0,0,0,0,0,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0,0},
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  {0,0,0,0,0,0,0,0,0,0,0,0,0,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0,0}
};
const byte PROGMEM alarmOnFrames[][288] = {
  {0,0,0,0,0,0,0,0,3,192,0,0,0,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0,0},
  {0,0,0,0,0,0,0,0,3,192,0,0,0,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0,0},
  {0,0,0,0,0,0,0,0,3,192,0,0,0,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0,0},
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  {0,0,0,0,0,0,0,0,3,192,0,0,0,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0,0}
};
const byte PROGMEM alarmOffFrames[][288] = {
  {0,0,0,0,0,0,0,0,3,192,0,0,0,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0,0},
  {0,0,0,0,0,0,0,0,3,192,0,0,0,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0,0},
  {0,0,0,0,0,0,0,0,3,192,0,0,0,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0,0},
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  {0,0,0,0,0,0,0,0,3,192,0,0,0,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0,0}
};

const char index_html[] PROGMEM = R"rawliteral(
<!DOCTYPE html>
<html lang="vi">
<head>
    <meta charset="UTF-8">
    <meta name="viewport" content="width=device-width, initial-scale=1.0">
    <title>VIRTUAL KEYBOARD</title>
    <style>
        body {
            font-family: 'Arial', sans-serif;
            text-align: center;
            background: rgba(255, 255, 255, 0.8);
            color: black;
            margin: 0;
            padding: 20px;
        }
        h2 {
            background: #E8E8E8;
            padding: 15px;
            border-radius: 30px;
            display: inline-block;
            font-size: 28px;
        }
        .led-container {
            display: flex;
            flex-wrap: wrap;
            justify-content: center;
            gap: 20px;
            margin-top: 20px;
        }
        .led-wrapper {
            display: flex;
            flex-direction: column;
            align-items: center;
        }
        .led {
            width: 60px;
            height: 60px;
            border-radius: 50%;
            background-color: #E8E8E8;
            box-shadow: 0 0 5px rgba(0, 0, 0, 0.3);
            transition: background-color 0.3s, box-shadow 0.3s;
        }
        .led.active {
            background-color: #DB7093;
            box-shadow: 0 0 20px #DB7093;
        }
        .keyboard {
            display: grid;
            gap: 10px;
            justify-content: center;
            width: 955px;
            margin: 20px auto;
            padding: 20px;
            border-radius: 30px;
            background: #E8E8E8;
            backdrop-filter: blur(10px);
            box-shadow: 0 0 5px rgba(54, 54, 54, 0.3);
        }
        .row {
            display: flex;
            justify-content: center;
            gap: 8px;
        }
        .key {
            padding: 15px 22px;
            border-radius: 10px;
            background: rgba(250, 250, 250, 1);
            backdrop-filter: blur(15px);
            font-size: 18px;
            text-align: center;
            cursor: pointer;
            min-width: 50px;
            transition: all 0.2s ease;
            border: 1px solid rgba(255, 255, 255, 0.3);
            box-shadow: 0 0 5px rgba(54, 54, 54, 0.3);
        }
        .key[data-key="Tab"] {
            padding: 15px 22px;
            border-radius: 10px;
            background: rgba(250, 250, 250, 1);
            backdrop-filter: blur(15px);
            font-size: 18px;
            text-align: left;
            cursor: pointer;
            min-width: 98px;
            transition: all 0.2s ease;
            border: 1px solid rgba(255, 255, 255, 0.3);
        }
        .key[data-key="\\"] {
            padding: 15px 22px;
            border-radius: 10px;
            background: rgba(250, 250, 250, 1);
            backdrop-filter: blur(15px);
            font-size: 18px;
            text-align: left;
            cursor: pointer;
            min-width: 70px;
            transition: all 0.2s ease;
            border: 1px solid rgba(255, 255, 255, 0.3);
        }
        .key[data-key="Capslock"] {
            padding: 15px 22px;
            border-radius: 10px;
            background: rgba(250, 250, 250, 1);
            backdrop-filter: blur(15px);
            font-size: 18px;
            text-align: left;
            cursor: pointer;
            min-width: 50px;
            transition: all 0.2s ease;
            border: 1px solid rgba(255, 255, 255, 0.3);
        }
        .key[data-key="Enter"] {
            padding: 15px 22px;
            border-radius: 10px;
            background: rgba(250, 250, 250, 1);
            backdrop-filter: blur(15px);
            font-size: 18px;
            text-align: right;
            cursor: pointer;
            min-width: 115px;
            transition: all 0.2s ease;
            border: 1px solid rgba(255, 255, 255, 0.3);
        }
        .key[data-key="ShiftLeft"] {
            padding: 15px 22px;
            border-radius: 10px;
            background: rgba(250, 250, 250, 1);
            backdrop-filter: blur(15px);
            font-size: 18px;
            text-align: left;
            cursor: pointer;
            min-width: 160px;
            transition: all 0.2s ease;
            border: 1px solid rgba(255, 255, 255, 0.3);
        }
        .key[data-key="ShiftRight"] {
            padding: 15px 22px;
            border-radius: 10px;
            background: rgba(250, 250, 250, 1);
            backdrop-filter: blur(15px);
            font-size: 18px;
            text-align: right;
            cursor: pointer;
            min-width: 147px;
            transition: all 0.2s ease;
            border: 1px solid rgba(255, 255, 255, 0.3);
        }
        .key[data-key=" "] {
            padding: 15px 22px;
            border-radius: 10px;
            background: rgba(250, 250, 250, 1);
            backdrop-filter: blur(15px);
            font-size: 18px;
            text-align: center;
            cursor: pointer;
            min-width: 215px;
            transition: all 0.2s ease;
            border: 1px solid rgba(255, 255, 255, 0.3);
        }
        .key.active {
            background: #FFC0CB;
            box-shadow: 0px 0px 20px #FFC0CB;
            transform: scale(1.15);
        }
        .output {
            margin-top: 10px;
            padding: 30px 40px;
            border-radius: 30px;
            background: #F5F5F5;
            width: 90%;
            width: 920px;
            min-height: 50px;
            font-size: 20px;
            word-wrap: break-word;
            margin-left: 30px;
            margin-right: 30px;
            box-shadow: 0 0 5px rgba(54, 54, 54, 0.3);
            text-align: left;
    		position: relative;
    		display: inline-block;
        }
        /* Tạo con trỏ nhấp nháy */
        .output::after {
            content: "_"; /* Dấu gạch đứng làm con trỏ */
            display: inline-block;
            margin-left: 0px;
            animation: blink 1s infinite;
            color: black;
        }

        @keyframes blink {
            0% { opacity: 1; }
            50% { opacity: 0; }
            100% { opacity: 1; }
        }
       
       /* Placeholder giả lập */
        .output:empty::before {
            content: "Message";
            color: gray;
            position: absolute;
            left: 30px;
            pointer-events: none;
        }
    </style>
</head>
<body>
    <h2>VIRTURAL KEYBOARD</h2>
    <div class="led-container" id="ledContainer"></div>
    <div class="keyboard" id="keyboard">
        <div class="row">
            <button class="key" data-key="`">`</button>
            <button class="key" data-key="1">1</button>
            <button class="key" data-key="2">2</button>
            <button class="key" data-key="3">3</button>
            <button class="key" data-key="4">4</button>
            <button class="key" data-key="5">5</button>
            <button class="key" data-key="6">6</button>
            <button class="key" data-key="7">7</button>
            <button class="key" data-key="8">8</button>
            <button class="key" data-key="9">9</button>
            <button class="key" data-key="0">0</button>
            <button class="key" data-key="-">-</button>
            <button class="key" data-key="=">=</button>
            <button class="key" data-key="Backspace">Backspace</button>
        </div>
        <div class="row">
            <button class="key" data-key="Tab">Tab</button>
            <button class="key" data-key="Q">Q</button>
            <button class="key" data-key="W">W</button>
            <button class="key" data-key="E">E</button>
            <button class="key" data-key="R">R</button>
            <button class="key" data-key="T">T</button>
            <button class="key" data-key="Y">Y</button>
            <button class="key" data-key="U">U</button>
            <button class="key" data-key="I">I</button>
            <button class="key" data-key="O">O</button>
            <button class="key" data-key="P">P</button>
            <button class="key" data-key="[">[</button>
            <button class="key" data-key="]">]</button>
            <button class="key" data-key="\">\</button>
        </div>
        <div class="row">
            <button class="key" data-key="Capslock">CapsLock</button>
            <button class="key" data-key="A">A</button>
            <button class="key" data-key="S">S</button>
            <button class="key" data-key="D">D</button>
            <button class="key" data-key="F">F</button>
            <button class="key" data-key="G">G</button>
            <button class="key" data-key="H">H</button>
            <button class="key" data-key="J">J</button>
            <button class="key" data-key="K">K</button>
            <button class="key" data-key="L">L</button>
            <button class="key" data-key=";">;</button>
            <button class="key" data-key="'">'</button>
            <button class="key" data-key="Enter">Enter</button>
        </div>
        <div class="row">
            <button class="key" data-key="ShiftLeft">Shift</button>
            <button class="key" data-key="Z">Z</button>
            <button class="key" data-key="X">X</button>
            <button class="key" data-key="C">C</button>
            <button class="key" data-key="V">V</button>
            <button class="key" data-key="B">B</button>
            <button class="key" data-key="N">N</button>
            <button class="key" data-key="M">M</button>
            <button class="key" data-key=",">,</button>
            <button class="key" data-key=".">.</button>
            <button class="key" data-key="/">/</button>
            <button class="key" data-key="ShiftRight">Shift</button>
        </div>
        <div class="row">
            <button class="key" data-key="Ctrl">Ctrl</button>
            <button class="key" data-key="Fn">Fn</button>
            <button class="key" data-key="Win">Win</button>
            <button class="key" data-key="Alt">Alt</button>
            <button class="key" data-key=" ">Space</button>
            <button class="key" data-key="Alt">Alt</button>
            <button class="key" data-key="Ctrl">Ctrl</button>
            <button class="key" data-key="Left">⇦</button>
            <button class="key" data-key="Right">⇨</button>
            <button class="key" data-key="Up">⇧</button>
            <button class="key" data-key="Down">⇩</button>
        </div>
    </div>
    <div class="output" id="output" ></div>

    <script>
        // Các hàm xử lí Led ảo
        const ledContainer = document.getElementById('ledContainer');
        for (let i = 0; i < 8; i++) {
            const ledWrapper = document.createElement('div');
            ledWrapper.classList.add('led-wrapper');

            const led = document.createElement('div');
            led.classList.add('led');
            led.id = `led${i}`;
                        
            ledWrapper.appendChild(led);
            ledContainer.appendChild(ledWrapper);
        }
        function toggleLed(index) {
            const led = document.getElementById(`led${index}`);
            if (led.classList.contains('active')) {
                led.classList.remove('active');
            } else {
                led.classList.add('active');
            }            
        }
        function onLed(index) {
            const led = document.getElementById(`led${index}`);
            led.classList.add('active');         
        }
        function offLed(index) {
            const led = document.getElementById(`led${index}`);
            led.classList.remove('active');         
        }
        function lightUpSequentially() {
            for (let i = 0; i < 8; i++) {
                setTimeout(() => {
                    onLed(i);
                }, i * 300);
            }
        }
        function turnOffSequentially() {
            for (let i = 0; i < 8; i++) {
                setTimeout(() => {
                    offLed(i);
                }, i * 300);  
            }
        }
        function lightUpAll() {
            for (let i = 0; i < 8; i++) {
                onLed(i);        
            }
        }
        function turnOffAll() {
            for (let i = 0; i < 8; i++) {
                offLed(i);       
            }
        }

        const output = document.getElementById('output');
        const keys = document.querySelectorAll('.key');

        const keyMap = new Map();
        keys.forEach(key => keyMap.set(key.dataset.key, key));

        function pressKey(keyElement) {
            if (!keyElement) return;

            keyElement.classList.add('active');
            setTimeout(() => keyElement.classList.remove('active'), 200);

            let text = keyElement.dataset.key;
            let textUpdate = output.innerHTML.replace(/&nbsp;/g, ' ');

            if (text === 'Backspace') {
                output.textContent = output.textContent.slice(0, -1);
                textUpdate = textUpdate.slice(0, -1);
                sendCommand(textUpdate);
            } else if (text === 'Enter') {
                if(textUpdate.startsWith("LED") && textUpdate.endsWith("TOG")){
                    let i = parseInt(textUpdate.substring(3,4)) - 1;
                    toggleLed(i);
                }
                else if(textUpdate.startsWith("LED") && textUpdate.endsWith("ON")){
                    let i = parseInt(textUpdate.substring(3,4)) - 1;
                    onLed(i);
                }
                else if(textUpdate.startsWith("LED") && textUpdate.endsWith("OFF")){
                    let i = parseInt(textUpdate.substring(3,4)) - 1;
                    offLed(i);
                }
                else if(textUpdate.startsWith("ON") && textUpdate.endsWith("ALL")){
                    lightUpAll();
                }
                else if(textUpdate.startsWith("OFF") && textUpdate.endsWith("ALL")){
                    turnOffAll();
                }
                else if(textUpdate.startsWith("ON") && textUpdate.endsWith("SEQ")){
                    lightUpSequentially();
                }
                else if(textUpdate.startsWith("OFF") && textUpdate.endsWith("SEQ")){
                    turnOffSequentially();
                }
                output.textContent += '|';
                textUpdate += '|';  
                sendCommand(textUpdate);            
                output.textContent = '';
            } else if (text === ' ') {
                output.innerHTML += "&nbsp;";
                textUpdate += ' ';
                sendCommand(textUpdate);
            } else if (!['Shift', 'Ctrl', 'Alt', 'CapsLock', 'Tab'].includes(text)) {
                output.textContent += text;
                textUpdate += text;
                sendCommand(textUpdate);
            }
        }

        // Xử lý khi click chuột
        keys.forEach(key => {
            key.addEventListener('click', () => pressKey(key));
        });

        // Xử lý khi nhấn phím trên bàn phím thật
        document.addEventListener('keydown', (event) => {
            let key = event.key;

            if (key.length === 1) {
                key = key.toUpperCase();
            }

            const keyElement = keyMap.get(key);
            if (keyElement) {
                pressKey(keyElement);
            }
        });
        
        //Xử lí WebSocket
        var gateway = `ws://${window.location.hostname}/ws`;
        let ws;
        function initWebSocket() {
            ws = new WebSocket(gateway);
            ws.onopen = () => console.log("WebSocket kết nối!");
            ws.onmessage = (event) => console.log("ESP32 gửi:", event.data);
            ws.onclose = () => setTimeout(initWebSocket, 1000);
        }
        function sendCommand(command) {
            if (ws && ws.readyState === WebSocket.OPEN) {
                ws.send(command);
            }
        }
        window.onload = initWebSocket;
    </script>
</body>
</html>
)rawliteral";

// Vẽ ảnh động
void drawLedOnFrames(void *pvParameters){
    for(int i = 0; i < FRAME_COUNT / 2; i++){
        display.clearDisplay();
        display.drawBitmap(40, 20, ledOnFrames[frame], 42, 42, 1);
        frame = (frame + 1) % (FRAME_COUNT / 2);
        display.display();
        vTaskDelay(42/portTICK_PERIOD_MS);
    }
    vTaskDelete(NULL);
}

void drawLedOffFrames(void *pvParameters){
    for(int i = 0; i < FRAME_COUNT / 2; i++){
        display.clearDisplay();
        display.drawBitmap(40, 20, ledOffFrames[frame], 42, 42, 1);
        frame = (frame + 1) % (FRAME_COUNT / 2);
        display.display();
        vTaskDelay(42/portTICK_PERIOD_MS);
    }
    vTaskDelete(NULL);
}

void drawAlarmOnFrames(void *pvParameters){
    for(int i = 0; i < FRAME_COUNT / 2; i++){
        display.clearDisplay();
        display.drawBitmap(40, 20, alarmOnFrames[frame], 42, 42, 1);
        frame = (frame + 1) % (FRAME_COUNT / 2);
        display.display();
        vTaskDelay(42/portTICK_PERIOD_MS);
    }
    vTaskDelete(NULL);
}

void drawAlarmOffFrames(void *pvParameters){
    for(int i = 0; i < FRAME_COUNT / 2; i++){
        display.clearDisplay();
        display.drawBitmap(40, 20, alarmOffFrames[frame], 42, 42, 1);
        frame = (frame + 1) % (FRAME_COUNT / 2);
        display.display();
        vTaskDelay(42/portTICK_PERIOD_MS);
    }
    vTaskDelete(NULL);
}

//Tạo sound
void alarm(void *pvParameters){
    if (pvParameters == NULL) {
        vTaskDelete(NULL); // Xóa task nếu không có tham số hợp lệ
        return;
    }

    bool ALARM = *(bool *)pvParameters;

    while(ALARM){
        digitalWrite(buzzerPins, HIGH);
        vTaskDelay(200/portTICK_PERIOD_MS);
        digitalWrite(buzzerPins, LOW);
        vTaskDelay(100/portTICK_PERIOD_MS);
        ALARM = *(bool *)pvParameters;
    }
    vTaskDelete(NULL);
}

void tickSound(void *pvParameters){
    digitalWrite(buzzerPins, HIGH);
    vTaskDelay(30/portTICK_PERIOD_MS);
    digitalWrite(buzzerPins, LOW);
    vTaskDelete(NULL);
}

//Led Control
void ledOn(void *pvParameters){
    int ledIndex = *(int *)pvParameters;
    digitalWrite(ledPins[ledIndex - 1], HIGH);
    vTaskDelete(NULL);
}

void ledOff(void *pvParameters){
    int ledIndex = *(int *)pvParameters;
    digitalWrite(ledPins[ledIndex - 1], LOW);
    vTaskDelete(NULL);
}

void ledTog(void *pvParameters){
    int ledIndex = *(int *)pvParameters;
    digitalWrite(ledPins[ledIndex - 1], !digitalRead(ledPins[ledIndex - 1]));  
    vTaskDelete(NULL);      
}

void ledOnAll(void *pvParameters){
    for (int i = 0; i < 8; i++) {
        digitalWrite(ledPins[i], HIGH);
    }
    vTaskDelete(NULL);
}

void ledOffAll(void *pvParameters){
    for (int i = 0; i < 8; i++) {
        digitalWrite(ledPins[i], LOW);
    }
    vTaskDelete(NULL);
}

void ledOnSeq(void *pvParameters){
    for (int i = 0; i < 8; i++) {
        digitalWrite(ledPins[i], HIGH);
        vTaskDelay(300 / portTICK_PERIOD_MS);
    }
    vTaskDelete(NULL);
}

void ledOffSeq(void *pvParameters){
    for (int i = 0; i < 8; i++) {
        digitalWrite(ledPins[i], LOW);
        vTaskDelay(300 / portTICK_PERIOD_MS);
    }
    vTaskDelete(NULL);
}

void ledSeqInf(void *pvParameters) {
    if (pvParameters == NULL) {
        vTaskDelete(NULL); // Xóa task nếu không có tham số hợp lệ
        return;
    }

    bool LEDINF = *(bool *)pvParameters;

    while (LEDINF) { 
        for (int i = 0; i < 8; i++) {
            digitalWrite(ledPins[i], HIGH);
            vTaskDelay(300 / portTICK_PERIOD_MS);
        }
        for (int i = 0; i < 8; i++) {
            digitalWrite(ledPins[i], LOW);
            vTaskDelay(300 / portTICK_PERIOD_MS);
        }

        // Cập nhật lại giá trị condition để có thể dừng vòng lặp
        LEDINF = *(bool *)pvParameters;
    }

    vTaskDelete(NULL); // Xóa task khi condition == false
}


//Hiện tin nhắn
void printMessage(String message){
    display.setTextSize(2);
    display.setCursor(1, 2);
    // Xử lý xóa kí tự đặc biệt để điều khiển ngoại vi của message
    if(message.endsWith("|")){
        display.println(message.substring(0, message.length() - 1) + "_");
    }
    else if(message.length() > 39) {
        display.println(message.substring(message.length() - 39) + "_");
    }
    else display.println(message + "_");
    display.display();
}

//
//
//Xử lí sự kiện WebSocket
String lastMessage = "";
void handleWebSocketMessage(void *arg, uint8_t *data, size_t len) {
    AwsFrameInfo *info = (AwsFrameInfo*)arg;
    if (info->final && info->index == 0 && info->len == len && info->opcode == WS_TEXT) {
        String message = String((char *)data).substring(0, min(len, strlen((char *)data)));
        Serial.println(message);
        delay(10);
        if(SOUND == true) xTaskCreate(tickSound, "tickSound", 1000, NULL, 1, NULL);

        // Hiển thị text lên OLED khi có nội dung mới hoặc thay đổi
        if (message != lastMessage) {
            display.clearDisplay();
            printMessage(message);
            lastMessage = message;
        }

        //Xử lí tin nhắn từ webSocket để điều khiển ngoại vi
        if (message.startsWith("LED")) {
            int ledIndex = message.substring(3,4).toInt();
            if (ledIndex >= 1 && ledIndex < 9) {
                if (message.endsWith("ON|")) {
                    xTaskCreate(ledOn, "ledOn", 1000, &ledIndex, 1, NULL);
                    xTaskCreate(drawLedOnFrames, "drawLedOnFrames", 10000, NULL, 1, NULL);       
                } 
                else if (message.endsWith("OFF|")) {
                    xTaskCreate(ledOff, "ledOff", 1000, &ledIndex, 1, NULL);
                    xTaskCreate(drawLedOffFrames, "drawLedOffFrames", 10000, NULL, 1, NULL); 
                } 
                else if (message.endsWith("TOG|")) {
                    xTaskCreate(ledTog, "ledTog", 1000, &ledIndex, 1, NULL);
                    if (digitalRead(ledPins[ledIndex - 1]) == HIGH){
                        xTaskCreate(drawLedOnFrames, "drawLedOnFrames", 10000, NULL, 1, NULL);
                    } 
                    else{
                        xTaskCreate(drawLedOffFrames, "drawLedOffFrames", 10000, NULL, 1, NULL); 
                    } 
                }
                printMessage(message);
            }
        }
        
        else if (message.startsWith("ON") && message.endsWith("ALL|")) {
            xTaskCreate(ledOnAll, "ledOnAll", 1000, NULL, 1, NULL);
            xTaskCreate(drawLedOnFrames, "drawLedOnFrames", 10000, NULL, 1, NULL);
            printMessage(message);
        } 

        else if (message.startsWith("OFF") && message.endsWith("ALL|")) {
            xTaskCreate(ledOffAll, "ledOffAll", 1000, NULL, 1, NULL);
            xTaskCreate(drawLedOffFrames, "drawLedOffFrames", 10000, NULL, 1, NULL);
            printMessage(message);
        } 

        else if (message.startsWith("ON") && message.endsWith("SEQ|")) {
            xTaskCreate(ledOnSeq, "ledOnSeq", 1000, NULL, 1, NULL);
            xTaskCreate(drawLedOnFrames, "drawLedOnFrames", 10000, NULL, 1, NULL);
            printMessage(message); 
        } 

        else if (message.startsWith("OFF") && message.endsWith("SEQ|")) {
            xTaskCreate(ledOffSeq, "ledOffSeq", 1000, NULL, 1, NULL);
            xTaskCreate(drawLedOffFrames, "drawLedOffFrames", 10000, NULL, 1, NULL);
            printMessage(message);
        }

        
        else if (message.startsWith("INF") && message.endsWith("SEQON|")) {
            LEDINF = true;
            xTaskCreate(ledSeqInf, "ledSeqInf", 8000, &LEDINF, 1, NULL);
            xTaskCreate(drawLedOnFrames, "drawLedOnFrames", 10000, NULL, 1, NULL);
            printMessage(message); 
        } 

        else if (message.startsWith("INF") && message.endsWith("SEQOFF|")) {
            LEDINF = false;
            xTaskCreate(ledOffAll, "ledOffAll", 1000, NULL, 1, NULL);
            xTaskCreate(ledSeqInf, "ledSeqInf", 8000, &LEDINF, 1, NULL);
            xTaskCreate(drawLedOffFrames, "drawLedOffFrames", 10000, NULL, 1, NULL);
            printMessage(message); 
        } 

        else if (message.startsWith("INV") && message.endsWith("ON|")) {
            printMessage(message);
            display.invertDisplay(true);
        }

        else if (message.startsWith("INV") && message.endsWith("OFF|")) {
            printMessage(message);
            display.invertDisplay(false);
        }

        else if (message.startsWith("SOUND") && message.endsWith("ON|")) {
            SOUND = true;
            xTaskCreate(drawAlarmOnFrames, "drawAlarmOnFrames", 10000, NULL, 1, NULL);
            printMessage(message);
        }

        else if (message.startsWith("SOUND") && message.endsWith("OFF|")) {
            SOUND = false;
            xTaskCreate(drawAlarmOffFrames, "drawAlarmOffFrames", 10000, NULL, 1, NULL);
            printMessage(message);
        }

        else if (message.startsWith("ALARM") && message.endsWith("ON|")) {
            SOUND = true;
            xTaskCreate(drawAlarmOnFrames, "drawAlarmOnFrames", 10000, NULL, 1, NULL);
            xTaskCreate(alarm, "alarm", 1000, &SOUND, 1, NULL);
            printMessage(message);
        }

        else if (message.startsWith("ALARM") && message.endsWith("OFF|")) {
            SOUND = false;
            xTaskCreate(drawAlarmOffFrames, "drawAlarmOffFrames", 10000, NULL, 1, NULL);
            xTaskCreate(alarm, "alarm", 1000, &SOUND, 1, NULL);
            printMessage(message);
        }
    }
}

void onWebSocketEvent(AsyncWebSocket *server, AsyncWebSocketClient *client, AwsEventType type, void *arg, uint8_t *data, size_t len) {
    switch (type) {
        case WS_EVT_CONNECT:
            Serial.printf("WebSocket client #%u connected from %s\n", client->id(), client->remoteIP().toString().c_str());
            break;
        case WS_EVT_DISCONNECT:
            Serial.printf("WebSocket client #%u disconnected\n", client->id());
            break;
        case WS_EVT_DATA:
            handleWebSocketMessage(arg, data, len);
            break;
        case WS_EVT_PONG:
        case WS_EVT_ERROR:
        break;
  }
}

void initWebSocket(){
    ws.onEvent(onWebSocketEvent);
    server.addHandler(&ws);
    server.begin();
}

void setup() {
    for (int i = 0; i < 8; i++) {
        pinMode(ledPins[i], OUTPUT);
        digitalWrite(ledPins[i], LOW);
    }
    pinMode(buzzerPins, OUTPUT);
    digitalWrite(buzzerPins, LOW);

    display.begin(SSD1306_SWITCHCAPVCC, 0x3C);
    display.clearDisplay();
    display.setTextSize(1);
    display.setTextColor(WHITE);
    display.setCursor(1, 2);
    display.println("Hello.....");
    display.display();
    delay(2000);

    Serial.begin(9600);
    Serial.print("Connecting to wifi");
    Serial.println(ssid);

    display.clearDisplay();
    display.setCursor(1, 2);
    display.print("Connecting to wifi");
    display.display();

    WiFi.begin(ssid, password);
    while (WiFi.status() != WL_CONNECTED) {
        delay(500);
        Serial.print(".");

        display.print(".");
        display.display();
    }
    Serial.println("\nWiFi connected");
    Serial.println(WiFi.localIP());

    display.clearDisplay();
    display.setCursor(1, 1);
    display.println("WiFi connected.");
    display.println(" ");
    display.print("IP: ");
    display.print(WiFi.localIP());
    display.display();
   
    initWebSocket();
    server.on("/", HTTP_GET, [](AsyncWebServerRequest *request){
        request->send_P(200, "text/html", index_html);
    });
}

void loop() {
    ws.cleanupClients();
    
}