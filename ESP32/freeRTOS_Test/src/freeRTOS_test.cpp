#include "Arduino.h"
#include "freertos/FreeRTOS.h"
#include "freertos/task.h"

#include <Wire.h>
#include <Adafruit_GFX.h>
#include <Adafruit_SSD1306.h>

#define SCREEN_WIDTH 128 // OLED display width, in pixels
#define SCREEN_HEIGHT 64 // OLED display height, in pixels
// Declaration for an SSD1306 display connected to I2C (SDA, SCL pins)
Adafruit_SSD1306 display(SCREEN_WIDTH, SCREEN_HEIGHT, &Wire, -1);

const int ledPins[8] = {12, 14, 27, 26, 25, 33, 32, 5};

int frame1 = 0;
int frame2 = 0;
int frame3 = 0;
int frame4 = 0;
#define FRAME_COUNT (sizeof(ledOnFrames) / sizeof(ledOnFrames[0]))
const byte PROGMEM ledOnFrames[][288] = {
  {0,0,0,0,0,0,0,0,0,0,0,0,0,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0,0},
  {0,0,0,0,0,0,0,0,0,0,0,0,0,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0,0},
  {0,0,0,0,0,0,0,0,0,0,0,0,0,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0,0},
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  {0,0,0,0,0,0,0,0,0,0,0,0,0,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0,0}
};
const byte PROGMEM ledOffFrames[][288] = {
  {0,0,0,0,0,0,0,0,0,0,0,0,0,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0,0},
  {0,0,0,0,0,0,0,0,0,0,0,0,0,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0,0},
  {0,0,0,0,0,0,0,0,0,0,0,0,0,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0,0},
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  {0,0,0,0,0,0,0,0,0,0,0,0,0,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0,0}
};
const byte PROGMEM alarmOnFrames[][288] = {
  {0,0,0,0,0,0,0,0,3,192,0,0,0,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0,0},
  {0,0,0,0,0,0,0,0,3,192,0,0,0,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0,0},
  {0,0,0,0,0,0,0,0,3,192,0,0,0,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0,0},
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  {0,0,0,0,0,0,0,0,3,192,0,0,0,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0,0}
};
const byte PROGMEM alarmOffFrames[][288] = {
  {0,0,0,0,0,0,0,0,3,192,0,0,0,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0,0},
  {0,0,0,0,0,0,0,0,3,192,0,0,0,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0,0},
  {0,0,0,0,0,0,0,0,3,192,0,0,0,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0,0},
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  {0,0,0,0,0,0,0,0,3,192,0,0,0,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0,0}
};


void drawLedOnFrames(void *pvParameters){
    while(1){
        display.drawBitmap(0, 20, ledOnFrames[frame1], 42, 42, 1);
        frame1 = (frame1 + 1) % FRAME_COUNT;
        vTaskDelay(84/portTICK_PERIOD_MS);
    }
}

void drawLedOffFrames(void *pvParameters){
    while(1){     
        display.drawBitmap(64, 20, ledOffFrames[frame2], 42, 42, 1);
        frame2 = (frame2 + 1) % FRAME_COUNT;     
        vTaskDelay(84/portTICK_PERIOD_MS);
    }
}

void count(void *pvParameters){
    int i = 0;
    while(1){
        if(i <= (FRAME_COUNT*10)) {i ++;} 
        else {i = 0;}
        display.setTextSize(2);
        display.setCursor(1, 1);
        display.print(i);
        vTaskDelay(84/portTICK_PERIOD_MS);
    }
}

void clrVsDisOled(void *pvParameters){
    while(1){
        display.clearDisplay();
        vTaskDelay(84/portTICK_PERIOD_MS);
        display.display();
    }
}
void seqLed(void *pvParameters){
    while(1){
        for (int i = 0; i < 8; i++) {
                digitalWrite(ledPins[i], HIGH);
                vTaskDelay(300/portTICK_PERIOD_MS);
            }
        for (int i = 0; i < 8; i++) {
                digitalWrite(ledPins[i], LOW);
                vTaskDelay(300/portTICK_PERIOD_MS);
            }
    }
}

void Task1(void *pvParameters) {
    while (1) {
        Serial.println("Task 1 đang chạy...");
        vTaskDelay(1000 / portTICK_PERIOD_MS);
    }
}

void Task2(void *pvParameters) {
    while (1) {
        Serial.println("Task 2 đang chạy...");
        vTaskDelay(2000 / portTICK_PERIOD_MS);
    }
}

void setup() {
    Serial.begin(9600);
    display.begin(SSD1306_SWITCHCAPVCC, 0x3C);
    display.clearDisplay();
    display.setTextSize(2);
    display.setTextColor(WHITE);
    display.setCursor(0, 10);
    display.println("Hello.....");
    display.display();

    for (int i = 0; i < 8; i++) {
        pinMode(ledPins[i], OUTPUT);
        digitalWrite(ledPins[i], LOW);
    }

    xTaskCreate(drawLedOnFrames, "task 1", 10000, NULL, 6, NULL);

    xTaskCreate(drawLedOffFrames, "task 2", 10000, NULL, 6, NULL);

    xTaskCreate(clrVsDisOled, "task 3", 8000, NULL, 6, NULL);

    xTaskCreate(seqLed, "task 4", 1000, NULL, 3, NULL);

    xTaskCreate(count, "task 5", 1000, NULL, 3, NULL);

    xTaskCreate(Task1, "Task 1", 1000, NULL, 1, NULL);

    xTaskCreate(Task2, "Task 2", 1000, NULL, 1, NULL);
}

void loop() {
}