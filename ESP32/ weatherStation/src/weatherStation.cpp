#include <Arduino.h>
#include <Adafruit_GFX.h>
#include <Adafruit_SSD1306.h>
#define SCREEN_WIDTH 128 // OLED display width, in pixels
#define SCREEN_HEIGHT 64 // OLED display height, in pixels
// Declaration for an SSD1306 display connected to I2C (SDA, SCL pins)
Adafruit_SSD1306 display(SCREEN_WIDTH, SCREEN_HEIGHT, &Wire, -1);

#include <LM75.h>
LM75 Temp0; //(0x48);

#include "DHT.h"
#define DHTPIN 25
#define DHTTYPE DHT11
DHT dht(DHTPIN, DHTTYPE);

const int buttonPin = 26;
const int alarmPin = 13;
uint8_t maxTemp = 32;

const int dataPin = 4;  // Chân DS của 74HC595, Chân DIO của TM1638
const int clockPin = 2; // Chân SH_CP của 74HC595, Chân CLK của TM1638
const int latchPin = 5; // Chân ST_CP của 74HC595
const int stbPin = 15;  // Chân STB của TM1638

                     /*0*/ /*1*/ /*2*/ /*3*/ /*4*/ /*5*/ /*6*/ /*7*/ /*8*/ /*9*/ 
uint8_t segCode[] = {0x3f, 0x06, 0x5b, 0x4f, 0x66, 0x6d, 0x7d, 0x07, 0x7f, 0x6f}; 
                  /*H*/ /*E*/ /*L*/ /*L*/ /*O*/ /*.*/ /*.*/ /*.*/ 
uint8_t text[] = {0x76, 0x79, 0x38, 0x38, 0x3f, 0x80, 0x80, 0x80};

#define FRAME_COUNT (sizeof(tempFrames) / sizeof(tempFrames[0]))
int frame = 0;
const byte PROGMEM tempFrames[][128] = {
  {0,3,192,0,0,6,96,0,0,12,48,0,0,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224,0},
  {0,3,192,0,0,6,96,0,0,12,48,0,0,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224,0},
  {0,3,192,0,0,6,96,0,0,12,48,0,0,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224,0},
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  {0,3,192,0,0,6,96,0,0,12,48,0,0,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224,0}
};

const byte PROGMEM huminityFrames[][128] = {
  {0,0,0,0,0,0,0,0,0,0,0,0,0,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0,0},
  {0,0,0,0,0,0,0,0,0,0,0,0,0,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0,0},
  {0,0,0,0,0,0,0,0,0,0,0,0,0,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0,0},
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  {0,0,0,0,0,0,0,0,0,0,0,0,0,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0,0}
};

const byte PROGMEM emoji1Frames[][128] = {
  {0,0,0,0,0,7,224,0,0,63,252,0,0,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0,0},
  {0,0,0,0,0,7,224,0,0,63,252,0,0,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0,0},
  {0,0,0,0,0,7,224,0,0,63,252,0,0,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0,0},
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  {0,0,0,0,0,7,224,0,0,63,252,0,0,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0,0}
};

const byte PROGMEM emoji2Frames[][128] = {
  {0,0,0,0,0,7,224,0,0,63,252,0,0,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0,0},
  {0,0,0,0,0,7,224,0,0,63,252,0,0,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0,0},
  {0,0,0,0,0,7,224,0,0,63,252,0,0,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0,0},
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  {0,0,0,0,0,7,224,0,0,63,252,0,0,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0,0}
};

void sendCommand(uint8_t value) { 
  digitalWrite(stbPin, LOW); 
  shiftOut(dataPin, clockPin, LSBFIRST, value); 
  digitalWrite(stbPin, HIGH); 
} 
 
void TM1638init() { 
  sendCommand(0x40); // set auto increment mode 
  digitalWrite(stbPin, LOW); 
  shiftOut(dataPin, clockPin, LSBFIRST, 0xc0);   // set starting address to 0 
  for(uint8_t i = 0; i < 16; i++) 
  { 
    shiftOut(dataPin, clockPin, LSBFIRST, 0x00); 
  } 
  digitalWrite(stbPin, HIGH); 
} 

void segDisplay(uint8_t data1, uint8_t data2, uint8_t data3, uint8_t data4, uint8_t data5, uint8_t data6, uint8_t data7, uint8_t data8) { 
  sendCommand(0x40); 
  digitalWrite(stbPin, LOW);
  shiftOut(dataPin, clockPin, LSBFIRST, 0xc0);  
  shiftOut(dataPin, clockPin, LSBFIRST, data1); 
  shiftOut(dataPin, clockPin, LSBFIRST, 0x00);
  shiftOut(dataPin, clockPin, LSBFIRST, data2); 
  shiftOut(dataPin, clockPin, LSBFIRST, 0x00);
  shiftOut(dataPin, clockPin, LSBFIRST, data3); 
  shiftOut(dataPin, clockPin, LSBFIRST, 0x00);
  shiftOut(dataPin, clockPin, LSBFIRST, data4); 
  shiftOut(dataPin, clockPin, LSBFIRST, 0x00);
  shiftOut(dataPin, clockPin, LSBFIRST, data5); 
  shiftOut(dataPin, clockPin, LSBFIRST, 0x00); 
  shiftOut(dataPin, clockPin, LSBFIRST, data6); 
  shiftOut(dataPin, clockPin, LSBFIRST, 0x00); 
  shiftOut(dataPin, clockPin, LSBFIRST, data7); 
  shiftOut(dataPin, clockPin, LSBFIRST, 0x00); 
  shiftOut(dataPin, clockPin, LSBFIRST, data8); 
  shiftOut(dataPin, clockPin, LSBFIRST, 0x00); 
  digitalWrite(stbPin, HIGH); 
} 

void setLed(uint8_t value) { 
  sendCommand(0x44); 
  digitalWrite(stbPin, LOW); 
  shiftOut(dataPin, clockPin, LSBFIRST, 0xC1 + (7 << 1)); 
  shiftOut(dataPin, clockPin, LSBFIRST, value); 
  digitalWrite(stbPin, HIGH); 

  digitalWrite(stbPin, LOW); 
  shiftOut(dataPin, clockPin, LSBFIRST, 0xC1 + (6 << 1)); 
  shiftOut(dataPin, clockPin, LSBFIRST, value >> 1); 
  digitalWrite(stbPin, HIGH); 

  digitalWrite(stbPin, LOW); 
  shiftOut(dataPin, clockPin, LSBFIRST, 0xC1 + (5 << 1)); 
  shiftOut(dataPin, clockPin, LSBFIRST, value >> 2); 
  digitalWrite(stbPin, HIGH); 

  digitalWrite(stbPin, LOW); 
  shiftOut(dataPin, clockPin, LSBFIRST, 0xC1 + (4 << 1)); 
  shiftOut(dataPin, clockPin, LSBFIRST, value >> 3); 
  digitalWrite(stbPin, HIGH); 

  digitalWrite(stbPin, LOW); 
  shiftOut(dataPin, clockPin, LSBFIRST, 0xC1 + (3 << 1)); 
  shiftOut(dataPin, clockPin, LSBFIRST, value >> 4); 
  digitalWrite(stbPin, HIGH); 

  digitalWrite(stbPin, LOW); 
  shiftOut(dataPin, clockPin, LSBFIRST, 0xC1 + (2 << 1)); 
  shiftOut(dataPin, clockPin, LSBFIRST, value >> 5); 
  digitalWrite(stbPin, HIGH); 

  digitalWrite(stbPin, LOW); 
  shiftOut(dataPin, clockPin, LSBFIRST, 0xC1 + (1 << 1)); 
  shiftOut(dataPin, clockPin, LSBFIRST, value >> 6); 
  digitalWrite(stbPin, HIGH); 

  digitalWrite(stbPin, LOW); 
  shiftOut(dataPin, clockPin, LSBFIRST, 0xC1 + (0 << 1)); 
  shiftOut(dataPin, clockPin, LSBFIRST, value >> 7); 
  digitalWrite(stbPin, HIGH); 
}

// Hàm gửi dữ liệu đến 74HC595
void sendData(byte data) {
  digitalWrite(latchPin, LOW);
  shiftOut(dataPin, clockPin, LSBFIRST, data);
  digitalWrite(latchPin, HIGH);
}

hw_timer_t* timer = NULL; //khơi tạo timer
portMUX_TYPE timerMux = portMUX_INITIALIZER_UNLOCKED; 

// hàm xử lý ngắt
void IRAM_ATTR onTimer() {   
  
}

void drawIcon(int h, int m){
  display.drawBitmap(101, 0, tempFrames[frame], 32, 32, 1);
  display.drawBitmap(95, 32, huminityFrames[frame], 32, 32, 1);
  if(h < m) display.drawBitmap(59, 32, emoji1Frames[frame], 32, 32, 1);
  else display.drawBitmap(59, 32, emoji2Frames[frame], 32, 32, 1);
  frame = (frame + 1) % FRAME_COUNT;
}
int m = 22;
void button(){
  if(digitalRead(buttonPin)==0){
    delay(10);
    if(digitalRead(buttonPin)==0){
      while(digitalRead(buttonPin)==0);
      m = m + 2;
      if(m > 50) m = 20;
    }
  }
}

void setup() {
  /*//khởi tạo timer với chu kì 1us vì thạch anh của ESP chạy 8MHz
  timer = timerBegin(0, 80, true);
  //khởi tạo hàm xử lý ngắt ngắt cho Timer
  timerAttachInterrupt(timer, &onTimer, true);
  //khởi tạo thời gian ngắt cho timer là 1s (1000000 us)
  timerAlarmWrite(timer, 10000000000000000, true);
  //bắt đầu chạy timer
  timerAlarmEnable(timer);*/

  pinMode(dataPin, OUTPUT);
  pinMode(clockPin, OUTPUT);
  pinMode(latchPin, OUTPUT);
  pinMode(buttonPin, INPUT);
  pinMode(alarmPin, OUTPUT);
  pinMode(stbPin, OUTPUT);

  dht.begin();
  Temp0.begin();

  sendCommand(0x88); 
  TM1638init();
  sendData(0x00);

  display.begin(SSD1306_SWITCHCAPVCC, 0x3C);
  display.clearDisplay();
  display.setTextSize(2);
  display.setTextColor(WHITE);
  display.setCursor(0, 10);
  display.println("Hello.....");
  display.display();

  segDisplay(text[0], text[1], text[2], text[3], text[4], text[5], text[6], text[7]);
  delay(2000);
}

void loop(){
  // Read humidity
  int humidity = dht.readHumidity();
  // Read temperature of DHT as Celsius (the default)
  int temp1 = dht.readTemperature();
  // Read temperature of LM75 as Celsius
  int temp2 = Temp0.getTemperature();
  // Compute average temperature
  int temp = (temp1 + temp2) / 2;
  // Compute heat index in Celsius (isFahreheit = false)
  int heatIndex = dht.computeHeatIndex(temp, humidity, false);
  button();
  display.clearDisplay();

  display.setCursor(7, 4);
  display.setTextSize(1);
  display.println("TempOut  TempIn");
  display.setTextSize(2);
  display.setCursor(8, 14);
  display.print(temp2);
  display.setTextSize(1);
  display.print("o");
  display.setTextSize(2);
  display.print("C");
  display.setCursor(60, 13);
  display.print(temp1);
  display.setTextSize(1);
  display.print("o");
  display.setTextSize(2);
  display.println("C");

  display.setCursor(5, 35);
  display.setTextSize(1);
  display.println("Humidity");
  display.setTextSize(2);
  display.setCursor(10, 45);
  display.print(humidity);
  display.print("%");
  drawIcon(heatIndex, m);

  display.drawLine(1, 1, 106, 1, WHITE);
  display.drawLine(1, 1, 1, 62, WHITE);
  display.drawLine(1, 62, 55, 62, WHITE);
  display.drawLine(55, 1, 55, 62, WHITE);
  display.drawLine(1, 31, 106, 31, WHITE);
  display.drawLine(106, 1, 106, 31, WHITE);
  if(heatIndex < m) display.invertDisplay(true);
  else display.invertDisplay(false);
  display.display();

  
  delay(40);
  segDisplay(segCode[m/10], segCode[m%10], 0x63, 0x39, segCode[heatIndex/10], segCode[heatIndex%10], 0x63, 0x39); 
}